## Kconfig
```kconfig
config ZMK_BEHAVIOR_PUSHBUTTON
    bool
    default y
    depends on DT_HAS_ZMK_BEHAVIOR_PUSHBUTTON_ENABLED
    select GPIO
```

## dts/bindings/behaviors/zmk,behavior-pushbutton.yaml
```yaml
description: |
  Push button behavior: drives a GPIO active for a fixed time when the key is
  pressed, e.g. to "press" a physical button through a transistor/optocoupler.

compatible: "zmk,behavior-pushbutton"

include: zero_param.yaml

properties:
  gpios:
    type: phandle-array
    required: true
    description: GPIO driven by this behavior (use the flags for active level)

  press-duration-ms:
    type: int
    default: 200
    description: How long the GPIO stays active after a key press
```
